## arch/x86/cpu/tangier/Kconfig
```kconfig
#
# Copyright (C) 2015 Intel, Inc
#
# SPDX-License-Identifier:	GPL-2.0+
#

config INTEL_TANGIER
	bool
	depends on INTEL_SCU

config SYS_CAR_ADDR
	hex
	default 0x19200000

config SYS_CAR_SIZE
	hex
	default 0x4000
	help
	  Space in bytes in eSRAM used as Cache-As-RAM (CAR).
	  Note this size must not exceed eSRAM's total size.

config SYS_USB_OTG_BASE
	hex
	default 0xf9100000

config SYS_EMMC_PORT_BASE
	hex
	default 0xff3fc000

config SYS_SD_PORT_BASE
	hex
	default 0xff3fa000

config SYS_TANGIER_PMU_BASE
	hex
	default 0xff00b000

config SCU_IPC_BASE
	hex
	default 0xff009000
```

## board/intel/edison/Kconfig
```kconfig
if TARGET_EDISON

config SYS_BOARD
	default "edison"

config SYS_VENDOR
	default "intel"

config SYS_SOC
	default "tangier"

config SYS_CONFIG_NAME
	default "edison"

config SYS_TEXT_BASE
	default 0x1101000

config FASTBOOT_VERIFY_GPT_PARTITIONS
	bool "Verify GPT information before flashing it to device"
	default n
	help
	  This option enables specific board verification code that
	  checks if the data provided to "fastboot flash gpt" command
	  can be flashed or not.

config EDISON_ENABLE_EMMC_PWR_ON_WP
	bool "Make the first 8MB of eMMC read-only for the booted OS"
	default n
	help
	  This option enables eMMC's Power On Write Protect feature on
	  the first 8MB. The protection is activated just before u-boot
	  passes control to the loaded OS.
	  By default in Edison running Brillo OS this area is allocated
	  for the Protective MBR, primary GPT header and GPT entries,
	  the partition containing u-boot and a 'security' partition
	  used by Brillo Verified Boot flow.
	  Additional partitions can be placed under the write protected
	  area by using more than one 8MB WP block in the u-boot code
	  or by changing the GPT layout of the first 8MB.
	  Once Power On Write Protect is enabled for a specific WP block
	  that block remains read-only until the next device's power cycle.
	  If this option is enabled and you want to write data in the
	  WP block then the only way to do it is to enter in FASTBOOT
	  from device's Power Off state. You can achieve that by
	  pressing and holding RM button while executing a power cycle on
	  the device. Release the RM button once fastboot logs appeared
	  in the serial console or more than 5 seconds passed since power on.

config BOARD_SPECIFIC_OPTIONS # dummy
	def_bool y
	select INTEL_SCU
	select INTEL_TANGIER

endif
```

## configs/edison_defconfig
```kconfig
CONFIG_X86=y
CONFIG_VENDOR_INTEL=y
CONFIG_TARGET_EDISON=y
CONFIG_DEFAULT_DEVICE_TREE="edison"
# CONFIG_CMD_IMLS is not set
# CONFIG_CMD_FLASH is not set
# CONFIG_CMD_SETEXPR is not set
# CONFIG_CMD_NFS is not set
# CONFIG_X86_SERIAL is not set
CONFIG_OF_CONTROL=y
CONFIG_OF_EMBED=y
CONFIG_PCI=y
CONFIG_DM_RTC=y
CONFIG_USE_PRIVATE_LIBGCC=y
CONFIG_SYS_VSNPRINTF=y
CONFIG_INTEL_SCU=y
CONFIG_TANGIER_SERIAL=y
CONFIG_SYS_TNG_SERIAL2=y
CONFIG_TANGIER_SDHCI=y
```
