/*
 * Copyright (c) 2015 Google, Inc
 *
 * SPDX-License-Identifier:	GPL-2.0+
 */

/dts-v1/;

/include/ "skeleton.dtsi"

/ {
	model = "Intel Edison";
	compatible = "intel,edison";

	chosen {
		stdout-path = &serial;
	};

	serial: serial {
		compatible = "intel,tng-uart";
	};
};
